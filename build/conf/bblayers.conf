## build/conf/bblayers.conf
```bitbake
LCONF_VERSION = "7"

BBPATH = "${TOPDIR}"
BBFILES ?= ""

BBLAYERS ?= " \
    ${TOPDIR}/../sources/core/meta \
    ${TOPDIR}/../sources/core/meta-poky \
    ${TOPDIR}/../sources/core/../meta-openembedded/meta-perl \
    ${TOPDIR}/../sources/core/../meta-openembedded/meta-python \
    ${TOPDIR}/../sources/core/../meta-openembedded/meta-filesystems \
    ${TOPDIR}/../sources/core/../meta-openembedded/meta-gnome \
    ${TOPDIR}/../sources/core/../meta-openembedded/meta-multimedia \
    ${TOPDIR}/../sources/core/../meta-openembedded/meta-networking \
    ${TOPDIR}/../sources/core/../meta-openembedded/meta-webserver \
    ${TOPDIR}/../sources/core/../meta-openembedded/meta-xfce \
    ${TOPDIR}/../sources/core/../meta-openembedded/meta-initramfs \
    ${TOPDIR}/../sources/core/../meta-openembedded/meta-oe \
    ${TOPDIR}/../sources/core/../meta-clang \
    ${TOPDIR}/../sources/core/../meta-browser/meta-chromium \
    ${TOPDIR}/../sources/core/../meta-qt5 \
    ${TOPDIR}/../sources/core/../meta-xilinx/meta-microblaze \
    ${TOPDIR}/../sources/core/../meta-xilinx/meta-xilinx-bsp \
    ${TOPDIR}/../sources/core/../meta-xilinx/meta-xilinx-pynq \
    ${TOPDIR}/../sources/core/../meta-xilinx/meta-xilinx-contrib \
    ${TOPDIR}/../sources/core/../meta-xilinx/meta-xilinx-standalone \
    ${TOPDIR}/../sources/core/../meta-xilinx-tools \
    ${TOPDIR}/../sources/core/../meta-petalinux \
    ${TOPDIR}/../sources/core/../meta-virtualization \
    ${TOPDIR}/../sources/core/../meta-openamp \
    ${TOPDIR}/../sources/core/../meta-jupyter \
    ${TOPDIR}/../sources/core/../meta-python2 \
    ${TOPDIR}/../sources/core/../meta-som \
    ${TOPDIR}/../sources/core/../meta-security \
    ${TOPDIR}/../sources/meta-sdr \
    ${TOPDIR}/../sources/meta-zynq-gr \
    ${TOPDIR}/../sources/core/../meta-security/meta-tpm \
"

BBLAYERS_NON_REMOVABLE ?= " \
    ${TOPDIR}/../sources/core/meta \
"
```

## sources/meta-zynq-gr/conf/layer.conf
```bitbake
# We have a conf and classes directory, add to BBPATH
BBPATH .= ":${LAYERDIR}"

# We have recipes-* directories, add to BBFILES
BBFILES += "${LAYERDIR}/recipes-*/*/*.bb \
            ${LAYERDIR}/recipes-*/*/*.bbappend \
            ${LAYERDIR}/recipes-*/*.bb \
		${LAYERDIR}/recipes-*/*.bbappend"

BBFILE_COLLECTIONS += "zynq-gr-layer"
BBFILE_PATTERN_zynq-gr-layer = "^${LAYERDIR}/"
BBFILE_PRIORITY_zynq-gr-layer = "4"

LAYERDEPENDS_zynq-gr-layer = "core"
LAYERSERIES_COMPAT_zynq-gr-layer = "gatesgarth"
```
